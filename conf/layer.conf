## conf/layer.conf
```bitbake
# We have a conf and classes directory, add to BBPATH
BBPATH .= ":${LAYERDIR}"

# We have recipes-* directories, add to BBFILES
BBFILES += "${LAYERDIR}/recipes-*/*/*.bb \
            ${LAYERDIR}/recipes-*/*/*.bbappend"

BBFILE_COLLECTIONS += "qboopi"
BBFILE_PATTERN_meta-qboopi = "^${LAYERDIR}/"
BBFILE_PRIORITY_meta-qboopi = "3"

LAYERDEPENDS_meta-qboopi = "core raspberrypi"
BBFILE_PATTERN_qboopi = "^${LAYERDIR}/"
LAYERSERIES_COMPAT_meta-qboopi = "core scarthgap"
LAYERSERIES_COMPAT_qboopi = "scarthgap"
```
